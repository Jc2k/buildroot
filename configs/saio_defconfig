## configs/saio_defconfig
```kconfig
BR2_arm=y
BR2_arm1176jzf_s=y
BR2_ARM_EABIHF=y
BR2_OPTIMIZE_2=y
BR2_TOOLCHAIN_BUILDROOT_GLIBC=y
BR2_PACKAGE_HOST_LINUX_HEADERS_CUSTOM_4_9=y
BR2_TOOLCHAIN_BUILDROOT_CXX=y
BR2_TARGET_GENERIC_HOSTNAME="gameboyzero"
BR2_TARGET_GENERIC_ISSUE="Welcome"
BR2_INIT_SYSTEMD=y
BR2_ENABLE_LOCALE_WHITELIST="C en_GB"
BR2_ROOTFS_OVERLAY="overlay"
BR2_ROOTFS_POST_BUILD_SCRIPT="board/raspberrypi0/post-build.sh"
BR2_ROOTFS_POST_IMAGE_SCRIPT="board/raspberrypi0/post-image.sh"
BR2_LINUX_KERNEL=y
BR2_LINUX_KERNEL_CUSTOM_GIT=y
BR2_LINUX_KERNEL_CUSTOM_REPO_URL="https://github.com/raspberrypi/linux.git"
BR2_LINUX_KERNEL_CUSTOM_REPO_VERSION="9126e25b0934bd7bd843763310ea4b34c6e139d0"
BR2_LINUX_KERNEL_DEFCONFIG="bcmrpi"
BR2_LINUX_KERNEL_CONFIG_FRAGMENT_FILES="linux/frag-minimal linux/frag-cpufreq-ondemand linux/frag-usbnet-module"
BR2_LINUX_KERNEL_DTS_SUPPORT=y
BR2_LINUX_KERNEL_INTREE_DTS_NAME="bcm2708-rpi-b-plus bcm2708-rpi-0-w"
BR2_PACKAGE_ALSA_UTILS=y
# BR2_PACKAGE_ALSA_UTILS_ALSAMIXER is not set
BR2_PACKAGE_RETROARCH=y
BR2_PACKAGE_LIBRETRO_GAMBATTE=y
BR2_PACKAGE_LIBRETRO_MGBA=y
BR2_PACKAGE_LIBRETRO_NESTOPIA=y
BR2_PACKAGE_LIBRETRO_PICODRIVE=y
BR2_PACKAGE_LIBRETRO_POCKETSNES=y
BR2_PACKAGE_EMULATIONSTATION=y
BR2_PACKAGE_OSD_SAIO=y
BR2_PACKAGE_GAMELINK=y
BR2_PACKAGE_SDL2=y
BR2_PACKAGE_SDL2_OPENGLES=y
BR2_PACKAGE_SDL2_MIXER=y
BR2_PACKAGE_LINUX_FIRMWARE_RTL_81XX=y
BR2_PACKAGE_RPI_FIRMWARE=y
BR2_PACKAGE_RPI_WIFI_FIRMWARE=y
BR2_PACKAGE_RPI_USERLAND=y
BR2_PACKAGE_PYTHON3=y
BR2_PACKAGE_PYTHON_RPI_GPIO=y
BR2_PACKAGE_PYTHON_SERIAL=y
BR2_PACKAGE_LIBPNG=y
BR2_PACKAGE_CURL=y
BR2_PACKAGE_BOOST=y
BR2_PACKAGE_DROPBEAR=y
BR2_PACKAGE_WPA_SUPPLICANT=y
BR2_PACKAGE_SYSTEMD_COREDUMP=y
BR2_TARGET_ROOTFS_EXT2=y
BR2_TARGET_ROOTFS_EXT2_4=y
BR2_TARGET_ROOTFS_EXT2_SIZE="300000"
# BR2_TARGET_ROOTFS_TAR is not set
BR2_PACKAGE_HOST_DOSFSTOOLS=y
BR2_PACKAGE_HOST_GENIMAGE=y
BR2_PACKAGE_HOST_MTOOLS=y
```

## package/emulationstation/Config.in
```kconfig
config BR2_PACKAGE_EMULATIONSTATION
        bool "Emulation Station"
	depends on BR2_INSTALL_LIBSTDCPP
	depends on BR2_PACKAGE_SDL2
	depends on BR2_PACKAGE_BOOST
	depends on BR2_PACKAGE_ALSA_LIB
	select BR2_PACKAGE_LIBFREEIMAGE
	select BR2_PACKAGE_FREETYPE
	select BR2_PACKAGE_EIGEN
	select BR2_PACKAGE_BOOST_FILESYSTEM
	select BR2_PACKAGE_BOOST_DATE_TIME
	select BR2_PACKAGE_BOOST_LOCALE
	select BR2_PACKAGE_BOOST_REGEX
	select BR2_PACKAGE_BOOST_THREAD
	select BR2_PACKAGE_LIBCURL
	select BR2_PACKAGE_OPENSSL

        help
          A multi emulator frontend.

	  https://github.com/Aloshi/EmulationStation

comment "Emulation station needs a toolchain w/ C++, ALSA, Boost, GLES and SDL"
	depends on !BR2_INSTALL_LIBSTDCPP || !BR2_PACKAGE_SDL2 || \
		!BR2_PACKAGE_BOOST || !BR2_PACKAGE_ALSA_LIB 
```

## package/gamelink/Config.in
```kconfig
config BR2_PACKAGE_GAMELINK
        bool "Gamelink"

        help
          Coordinates gamelink and retroplay master/server status
```

## package/osd-saio/Config.in
```kconfig
config BR2_PACKAGE_OSD_SAIO
	bool "osd-saio"
	help
	  Libretro implementation of gambatte (GB, GBC)

	  https://github.com/libretro/gambatte-libretro
```
